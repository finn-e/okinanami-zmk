#include "okinanami.dtsi"
&kscan0 {
    diode-direction = "row2col";
    col-gpios
      = <&pro_micro 14 GPIO_ACTIVE_HIGH>
      , <&pro_micro 15 GPIO_ACTIVE_HIGH>
      , <&pro_micro 18 GPIO_ACTIVE_HIGH>
      , <&pro_micro 19 GPIO_ACTIVE_HIGH>
      , <&pro_micro 20 GPIO_ACTIVE_HIGH>
      , <&pro_micro 21 GPIO_ACTIVE_HIGH>
    ;
};

&default_transform {
  col-offset = <6>;
};
